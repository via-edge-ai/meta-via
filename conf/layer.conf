## conf/layer.conf
```bitbake
# We have a conf and classes directory, add to BBPATH
BBPATH .= ":${LAYERDIR}"

# We have recipes-* directories, add to BBFILES
BBFILES += "${LAYERDIR}/recipes-*/*/*.bb \
            ${LAYERDIR}/recipes-*/*/*.bbappend"

BBFILE_COLLECTIONS += "meta-via"
BBFILE_PATTERN_meta-via = "^${LAYERDIR}/"
BBFILE_PRIORITY_meta-via = "8"

LAYERDEPENDS_meta-via = "core"
LAYERSERIES_COMPAT_meta-via = "kirkstone"
```
